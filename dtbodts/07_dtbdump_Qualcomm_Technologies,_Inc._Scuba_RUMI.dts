/dts-v1/;

/ {
	compatible = "qcom,scuba-rumi", "qcom,scuba", "qcom,rumi";
	model = "Qualcomm Technologies, Inc. Scuba RUMI";
	qcom,board-id = <0xf 0x0>;
	qcom,msm-id = <0x1b9 0x10000>;

	__fixups__ {
		L14A = "/fragment@2/__overlay__:vdd-io-supply:0";
		L19A = "/fragment@2/__overlay__:vdd-supply:0";
		L21A = "/fragment@3/__overlay__:vdd-supply:0";
		L4A = "/fragment@3/__overlay__:vdd-io-supply:0";
		qupv3_se1_i2c = "/fragment@5:target:0";
		rpmcc = "/fragment@4:target:0";
		sdc1_clk_off = "/fragment@2/__overlay__:pinctrl-1:0";
		sdc1_clk_on = "/fragment@2/__overlay__:pinctrl-0:0";
		sdc1_cmd_off = "/fragment@2/__overlay__:pinctrl-1:4";
		sdc1_cmd_on = "/fragment@2/__overlay__:pinctrl-0:4";
		sdc1_data_off = "/fragment@2/__overlay__:pinctrl-1:8";
		sdc1_data_on = "/fragment@2/__overlay__:pinctrl-0:8";
		sdc1_rclk_off = "/fragment@2/__overlay__:pinctrl-1:12";
		sdc1_rclk_on = "/fragment@2/__overlay__:pinctrl-0:12";
		sdc2_clk_off = "/fragment@3/__overlay__:pinctrl-1:0";
		sdc2_clk_on = "/fragment@3/__overlay__:pinctrl-0:0";
		sdc2_cmd_off = "/fragment@3/__overlay__:pinctrl-1:4";
		sdc2_cmd_on = "/fragment@3/__overlay__:pinctrl-0:4";
		sdc2_data_off = "/fragment@3/__overlay__:pinctrl-1:8";
		sdc2_data_on = "/fragment@3/__overlay__:pinctrl-0:8";
		sdhc_1 = "/fragment@2:target:0";
		sdhc_2 = "/fragment@3:target:0";
		soc = "/fragment@0:target:0";
		usb0 = "/fragment@1:target:0";
		usb_nop_phy = "/fragment@1/__overlay__/dwc3@4e00000:usb-phy:4";
		xo_board = "/fragment@0/__overlay__/bi_tcxo:clocks:0", "/fragment@0/__overlay__/bi_tcxo_ao:clocks:0";
	};

	__local_fixups__ {

		fragment@1 {

			__overlay__ {

				dwc3@4e00000 {
					usb-phy = <0x0>;
				};
			};
		};
	};

	__symbols__ {
		bi_tcxo = "/fragment@0/__overlay__/bi_tcxo";
		bi_tcxo_ao = "/fragment@0/__overlay__/bi_tcxo_ao";
		usb_emu_phy = "/fragment@0/__overlay__/usb_emu_phy@4f20000";
		wdog = "/fragment@0/__overlay__/qcom,wdt@f017000";
	};

	fragment@0 {
		target = <0xffffffff>;

		__overlay__ {

			bi_tcxo {
				#clock-cells = <0x0>;
				clock-div = <0x2>;
				clock-mult = <0x1>;
				clocks = <0xffffffff>;
				compatible = "fixed-factor-clock";
				phandle = <0x3>;
			};

			bi_tcxo_ao {
				#clock-cells = <0x0>;
				clock-div = <0x2>;
				clock-mult = <0x1>;
				clocks = <0xffffffff>;
				compatible = "fixed-factor-clock";
				phandle = <0x4>;
			};

			qcom,wdt@f017000 {
				phandle = <0x2>;
				status = "disabled";
			};

			timer {
				clock-frequency = <0x7a120>;
			};

			timer@f120000 {
				clock-frequency = <0x7a120>;
			};

			usb_emu_phy@4f20000 {
				compatible = "qcom,usb-emu-phy";
				phandle = <0x1>;
				qcom,emu-init-seq = <0xffff 0x4 0xfff0 0x4 0x100000 0x20 0x0 0x20 0x101f0 0x20 0x100000 0x3c 0x0 0x3c 0x10060 0x3c 0x0 0x4>;
				reg = <0x4f20000 0x9500 0x4ef8800 0x100>;
				reg-names = "base", "qscratch_base";
			};
		};
	};

	fragment@1 {
		target = <0xffffffff>;

		__overlay__ {

			dwc3@4e00000 {
				dr_mode = "peripheral";
				maximum-speed = "high-speed";
				usb-phy = <0x1 0xffffffff>;
			};
		};
	};

	fragment@2 {
		target = <0xffffffff>;

		__overlay__ {
			pinctrl-0 = <0xffffffff 0xffffffff 0xffffffff 0xffffffff>;
			pinctrl-1 = <0xffffffff 0xffffffff 0xffffffff 0xffffffff>;
			pinctrl-names = "active", "sleep";
			qcom,bus-speed-mode = "DDR_1p8v";
			qcom,clk-rates = <0x61a80 0x1312d00 0x17d7840 0x2faf080>;
			qcom,vdd-current-level = <0x0 0x8b290>;
			qcom,vdd-io-always-on;
			qcom,vdd-io-current-level = <0x0 0x4f588>;
			qcom,vdd-io-lpm-sup;
			qcom,vdd-io-voltage-level = <0x1b7740 0x1b7740>;
			qcom,vdd-voltage-level = <0x2d2a80 0x2d2a80>;
			status = "ok";
			vdd-io-supply = <0xffffffff>;
			vdd-supply = <0xffffffff>;
		};
	};

	fragment@3 {
		target = <0xffffffff>;

		__overlay__ {
			pinctrl-0 = <0xffffffff 0xffffffff 0xffffffff>;
			pinctrl-1 = <0xffffffff 0xffffffff 0xffffffff>;
			pinctrl-names = "active", "sleep";
			qcom,bus-speed-mode = "SDR12", "SDR25", "SDR50";
			qcom,clk-rates = <0x61a80 0x1312d00 0x17d7840 0x2faf080>;
			qcom,vdd-current-level = <0x0 0xc3500>;
			qcom,vdd-io-current-level = <0x0 0x55f0>;
			qcom,vdd-io-voltage-level = <0x1b7740 0x2d2a80>;
			qcom,vdd-voltage-level = <0x2d2a80 0x2d2a80>;
			status = "ok";
			vdd-io-supply = <0xffffffff>;
			vdd-supply = <0xffffffff>;
		};
	};

	fragment@4 {
		target = <0xffffffff>;

		__overlay__ {
			#clock-cells = <0x1>;
			#reset-cells = <0x1>;
			clock-output-names = "rpmcc_clocks";
			compatible = "qcom,dummycc";
		};
	};

	fragment@5 {
		target = <0xffffffff>;

		__overlay__ {
			status = "disabled";
		};
	};
};
